## config/west.yml
```yaml
manifest:
  remotes:
    - name: zmkfirmware
      url-base: https://github.com/yanghu
  projects:
    - name: zmk
      remote: zmkfirmware
      revision: build-with-submodules
      import: app/west.yml
  self:
    path: config
```
