#include <behaviors.dtsi>
#include <dt-bindings/zmk/keys.h>
#include <dt-bindings/zmk/bt.h>
#include <dt-bindings/zmk/outputs.h>

#include "zmk-helpers/helper.h"
#include "zmk-helpers/key-labels/42.h"

// layer defines
#define DEFAULT 0
#define SYMBOL 1
#define FUNC 2
#define NAV 3
#define NUMPAD 4
#define PSCR 5

#define ____ &trans
#define XXXX &none
#define BT(x) &bt BT_SEL x

/ {
  chosen {
    zmk,physical-layout = &foostan_corne_6col_layout;
    //zmk,physical-layout = &foostan_corne_5col_layout;
  };
};

// Sticky key config
&sk {
  release-after-ms = <600>; // release after 0.6s
  quick-release;
};

ZMK_BEHAVIOR(prog_caps_word, caps_word,
    continue-list = <UNDERSCORE>;
    )

// Sticky Shift/ caps word/ Capslock tap dance
ZMK_BEHAVIOR(td_caps, tap_dance,
        tapping-term-ms = <130>;
        bindings = <&kp LSHFT>, <&prog_caps_word>, <&kp CAPS>;
    )

// Home row mods
ZMK_BEHAVIOR(lht, hold_tap,
    flavor = "balanced";
    hold-trigger-key-positions = < 
      RT0 RT1 RT2 RT3 RT4 RT5 
      RM0 RM1 RM2 RM3 RM4 RM5 
      RB0 RB1 RB2 RB3 RB4 RB5 
      RH0 RH1 RH2
      LM3 LM4 LB1 LB2 LT3
    >;
    require-prior-idle-ms = <80>;
    tapping-term-ms = <180>;
    quick-tap-ms = <80>;
    bindings = <&kp>, <&kp>;
    )

ZMK_BEHAVIOR(rht, hold_tap,
    flavor = "balanced";
    hold-trigger-key-positions = < 
      LT0 LT1 LT2 LT3 LT4 LT5 
      LM0 LM1 LM2 LM3 LM4 LM5 
      LB0 LB1 LB2 LB3 LB4 LB5 
      LH0 LH1 LH2
    >;
    tapping-term-ms = <200>;
    require-prior-idle-ms = <100>;
    quick-tap-ms = <100>;
    bindings = <&kp>, <&kp>;
    )

ZMK_BEHAVIOR(n_lt, hold_tap,
    flavor = "tap-preferred";
    require-prior-idle-ms = <90>;
    tapping-term-ms = <150>;
    quick-tap-ms = <90>;
    hold-trigger-key-positions = < 
      RT1 RT2 RT3
      RM1 RM2 RM3
      RB1 RB2 RB3
      RH1
    >;
    bindings = <&mo>, <&kp>;
    )

// for alt+tab with SYMBOL + CAPS
ZMK_BEHAVIOR(swapper, tri_state,
    bindings = <&kt LALT>, <&kp TAB>, <&kt LALT>;
    ignored-key-positions = <LM5>;
    )

// BSPC, shift as delete
ZMK_BEHAVIOR(bspc_del, mod_morph,
    bindings = <&kp BSPC>, <&kp DEL>;
    mods = <(MOD_LSFT|MOD_RSFT)>;
    )


// combos
ZMK_COMBO(combo_esc, &kp ESC, RB1 RB2, DEFAULT)
ZMK_COMBO(combo_paste, &kp LC(LS(V)), LM4 LM3 LB1, ALL)
ZMK_COMBO(combo_lock, &kp LG(L), RB1 RB2, SYMBOL)

/ {
        keymap {
                compatible = "zmk,keymap";
                default_layer {
                        display-name = "QWERTY";
// -----------------------------------------------------------------------------------------
// |  TAB  |  Q  |  W  |  E  |  R  |  T     |   |  Y      |  U   |  I  |  O  |  P  | BKSP |
// | S/CAPS|  A  |  S  |  D  |  F  |  G     |   |  H      |  J   |  K  |  L  |  ;  |  '   |
// | CTRL  |  Z  |  X  |  C  |  V  |  B     |   |  N      |  M   |  ,  |  .  |  /  | ENT  |
//                     | GUI | SYM | NAV_ENT|   | sk SHIFT| SPC  | ALT |
                        bindings = <
//╭──────────┬─────────────┬─────────────┬───────┬─────────────┬─────────────╮   ╭───────────┬─────────┬─────────────┬────────┬────────┬────────╮
   &kp TAB    &kp Q         &kp W         &kp E   &kp R         &kp T             &kp Y       &kp U     &kp I         &kp O    &kp P    &bspc_del
//├──────────┼─────────────┼─────────────┼───────┼─────────────┼─────────────┤   ├───────────┼─────────┼─────────────┼────────┼────────┼────────┤
   &td_caps   &lht LCTRL A  &lht LSHFT S  &kp D   &n_lt NUMPAD F &kp G            &kp H       &kp J     &rht LCTRL K  &kp L    &kp SEMI &kp SQT
//├──────────┼─────────────┼─────────────┼───────┼─────────────┼─────────────┤   ├───────────┼─────────┼─────────────┼────────┼────────┼────────┤
   &kp LCTRL  &kp Z         &kp X         &kp C   &kp V         &kp B             &kp N       &kp M     &kp COMMA     &kp DOT  &kp FSLH &lt PSCR RET
//╰──────────┼─────────────┼─────────────┼───────┼─────────────┼─────────────┤   ├───────────┼─────────┼─────────────┼────────┼────────┼────────╯
                                         &kp LGUI &mo SYMBOL    &lt NAV RET       &sk LSHIFT  &kp SPACE &kp LALT
//                                       ╰───────┴─────────────┴─────────────╯   ╰───────────┴─────────┴─────────────╯

                        >;
                };

                symbol_layer {
                        display-name = "SYMBOL";
// -----------------------------------------------------------------------------------------
// |  ~  |  !  |  @  |  #  |  $  |  %     |   |  ^      |  &  |  *  |  (  |  )  | BKSP    |
// |A-Tab|  [  |  {  |  }  |  ]  | g-␣    |   | c-^     |  -  |  =  |  _  |  :  |  "      |
// |     |  |  |  `  |  \  |  ~  | c-␣    |   |         |  +  |  <  |  >  |  ?  |TO(LAYERS|
//                   | GUI | SYM | NAV_ENT|   | FUNC    | 0   | CTRL|
                        bindings = <
//╭──────────┬─────────┬─────────┬─────────┬───────┬─────────────╮   ╭─────────────┬─────────┬─────────┬─────────┬──────────┬───────╮
   &kp TILDE  &kp EXCL  &kp AT   &kp HASH  &kp DLLR &kp PRCNT         &kp CARET     &kp AMPS  &kp STAR  &kp LPAR  &kp RPAR   ____
//├──────────┼─────────┼─────────┼─────────┼───────┼─────────────┤   ├─────────────┼─────────┼─────────┼─────────┼──────────┼───────┤
   &swapper   &kp LBKT  &kp RBKT &kp LBRC  &kp RBRC &kp LG(SPACE)     &kp LC(CARET) &kp MINUS &kp EQUAL &kp UNDER &kp COLON  &kp DQT
//├──────────┼─────────┼─────────┼─────────┼───────┼─────────────┤   ├─────────────┼─────────┼─────────┼─────────┼──────────┼───────┤
   ____       &kp PIPE  &kp GRAVE &kp BSLH &kp TILDE &kp LC(SPACE)     XXXX         &kp PLUS  &kp LT    &kp GT    &kp QMARK ____
//╰──────────┼─────────┼─────────┼─────────┼───────┼─────────────┤   ├─────────────┼─────────┼─────────┼─────────┼──────────┼───────╯
                                  &to NUMPAD  ____   &to NAV              &mo FUNC       &kp N0    ____
//                               ╰─────────┴───────┴─────────────╯   ╰─────────────┴─────────┴─────────╯
                        >;
                };

                func_layer {
                        display-name = "FUNC";
// ╭──────┬───────┬─────┬─────┬─────┬─────╮   ╭─────┬──────────┬─────┬─────┬─────┬──────╮
// |  F1  | F2    | F3  | F4  | F5  | F6  |   | F7  | F8       | F9  | F10 | F11 |  F12 |
// | BTCLR| BT1   | BT2 | BT3 | BT4 | BT5 |   |     |          |     |     |     |      |
// | RESET|OUT_TOG|     |     |     |     |   |     |          |     |     |     |      |
//                      |     |     |     |   |     |BOOTLOADER|     |
//                      ╰─────┴─────┴─────╯   ╰─────┴──────────┴─────╯
                        bindings = <
//╭──────────┬─────────┬────────┬──────┬───────┬───────╮   ╭──────┬─────────┬─────────┬─────────┬──────────┬───────╮
   &kp F1      &kp F2   &kp F3   &kp F4 &kp F5  &kp F6      &kp F7  &kp F8   &kp F9    &kp F10   &kp F11    &kp F12
//├──────────┼─────────┼────────┼──────┼───────┼───────┤   ├──────┼─────────┼─────────┼─────────┼──────────┼───────┤
   &bt BT_CLR  BT(0)    BT(1)    BT(2)  BT(3)   BT(4)        ____   ____     ____      ____      ____       ____
//├──────────┼─────────┼────────┼──────┼───────┼───────┤   ├──────┼─────────┼─────────┼─────────┼──────────┼───────┤
   ____       &out OUT_TOG ____  ____   &sys_reset  &bootloader &bootloader &sys_reset ____      ____      ____       ____
//╰──────────┼─────────┼────────┼──────┼───────┼───────┤   ├──────┼─────────┼─────────┼─────────┼──────────┼───────╯
                                 ____    ____    ____         ____  ____     ____
//                              ╰──────┴───────┴───────╯   ╰──────┴─────────┴─────────╯
                        >;
                };

                nav_layer {
                        display-name = "NAVI";
// -----------------------------------------------------------------------------------------
// |  TAB |A(1) |A(2) |A(3) |A(4) |A(5) |   |HOME |PG_UP| END |     |     |      |
// |      |CTRL |SHIFT|PG_DN|CTRL |     |   | LFT | DWN |  UP | RGT |     |      |
// |      |     |     |MUTE |VOL- |VOL+ |   |     |     |     |     |     |      |
//                    | GUI |     |     |   | SHFT|     | ALT |
                        bindings = <
//╭──────┬──────────┬─────────┬───────────┬────────────┬────────────╮   ╭────────┬─────────┬─────────┬──────┬─────┬───────╮
   ____   &kp LA(N1) &kp LA(N2) &kp LA(N3) &kp LA(N4)   &kp LA(N5)       &kp HOME &kp PG_UP &kp END   XXXX   XXXX  XXXX
//├──────┼──────────┼─────────┼───────────┼────────────┼────────────┤   ├────────┼─────────┼─────────┼──────┼─────┼───────┤
   ____   &kp LCTRL  &kp LSHFT &kp PG_DN   &kp LCTRL    XXXX             &kp LEFT &kp DOWN  &kp UP  &kp RIGHT  XXXX  XXXX
//├──────┼──────────┼─────────┼───────────┼────────────┼────────────┤   ├────────┼─────────┼─────────┼──────┼─────┼───────┤
   XXXX   XXXX       XXXX      &kp C_MUTE  &kp C_VOL_DN &kp C_VOL_UP     XXXX     XXXX      XXXX      XXXX   XXXX  XXXX
//╰──────┼──────────┼─────────┼───────────┼────────────┼────────────┤   ├────────┼─────────┼─────────┼──────┼─────┼───────╯
                       	        ____         ____       &to DEFAULT      ____      ____     ____
//                            ╰───────────┴────────────┴────────────╯   ╰────────┴─────────┴─────────╯
                        >;
                };

                num_layer {
                        display-name = "NUMPAD";
// -----------------------------------------------------------------------------------------
// | TAB  |       |       |      |     |       |   |     |  7  |  8  |  9  |  +  |   |
// |S(GUI)|S(CTRL)|S(SHFT)|S(ALT)|     |       |   |     |  4  |  5  |  6  |  -  | * |
// | SHFT | LGUI  |       |      |     |       |   |     |  1  |  2  |  3  |  /  | = |
//                        | GUI  | SYM |NAV_ENT|   |P_ENT|  0  | .   |
                        bindings = <
//╭─────────┬──────────┬─────────┬───────────┬──────┬──────╮   ╭───────────┬───────┬───────┬──────┬─────────┬──────────╮
   ____      ____       ____      ____        ____   ____       &to DEFAULT &kp N7  &kp N8  &kp N9  &kp PLUS  ____
//├─────────┼──────────┼─────────┼───────────┼──────┼──────┤   ├───────────┼───────┼───────┼──────┼─────────┼──────────┤
   &sk LGUI  &sk LCTRL  &sk LSHFT  &sk LALT   ____   ____        ____       &kp N4  &kp N5  &kp N6  &kp MINUS &kp STAR
//├─────────┼──────────┼─────────┼───────────┼──────┼──────┤   ├───────────┼───────┼───────┼──────┼─────────┼──────────┤
   &kp LSHFT &kp LGUI   ____      ____        ____   ____        ____       &kp N1  &kp N2  &kp N3  &kp SLASH &kp EQUAL
//╰─────────┼──────────┼─────────┼───────────┼──────┼──────┤   ├───────────┼───────┼───────┼──────┼─────────┼──────────╯
                                  ____        ____   ____       &kp KP_ENTER &kp N0 &kp DOT 
//                               ╰───────────┴──────┴──────╯   ╰───────────┴───────┴───────╯
                        >;
                }; // num_layer

                screenshot_layer {
                        display-name = "PSCR";
                        bindings = <
//╭────────┬─────────┬─────────┬─────┬─────┬────╮   ╭─────┬─────┬─────┬──────┬────┬─────────╮
   XXXX     XXXX      XXXX      XXXX  XXXX  XXXX     XXXX  XXXX  XXXX  XXXX  XXXX  &kp LS(PSCRN)
//├────────┼─────────┼─────────┼─────┼─────┼────┤   ├─────┼─────┼─────┼──────┼────┼─────────┤
   XXXX     &kp LCTRL &kp LSHFT XXXX  XXXX  XXXX     XXXX  XXXX  XXXX  XXXX  XXXX  &kp PSCRN
//├────────┼─────────┼─────────┼─────┼─────┼────┤   ├─────┼─────┼─────┼──────┼────┼─────────┤
   &kp LALT  XXXX      XXXX      XXXX  XXXX  XXXX     XXXX  XXXX  XXXX  XXXX  XXXX  ____
//╰────────┼─────────┼─────────┼─────┼─────┼────┤   ├─────┼─────┼─────┼──────┼────┼─────────╯
                                ____  ____  ____     ____  ____  ____
//                             ╰─────┴─────┴────╯   ╰─────┴─────┴─────╯
                        >;
                }; // screenshot layr

        };  // keymap

}; // root

