#include <behaviors.dtsi>
#include <dt-bindings/zmk/keys.h>
#include <dt-bindings/zmk/bt.h>
#include <dt-bindings/zmk/outputs.h>

#include "../zmk-nodefree-config/helper.h"
#include "../zmk-nodefree-config/keypos_def/keypos_42keys.h"

// layer defines
#define DEFAULT 0
#define SYMBOL 1
#define FUNC 2
#define NAV 3
#define NUMPAD 4
#define PSCR 5

#define ____ &trans
#define XXXX &none
#define BT(x) &bt BT_SEL x

/ {
  chosen {
    zmk,matrix_transform = &default_transform;
    //zmk,matrix_transform = &five_column_transform;
  };
};

// Sticky key config
&sk {
  release-after-ms = <600>; // release after 0.6s
  quick-release;
};

ZMK_BEHAVIOR(prog_caps_word, caps_word,
    continue-list = <UNDERSCORE>;
    )

// Sticky Shift/ caps word/ Capslock tap dance
ZMK_BEHAVIOR(td_caps, tap_dance,
        tapping-term-ms = <130>;
        bindings = <&kp LSHFT>, <&prog_caps_word>, <&kp CAPS>;
    )

// Ctrl/ESC, caps word tap dance
ZMK_BEHAVIOR(td_esc_caps, tap_dance,
        tapping-term-ms = <130>;
        bindings = <&mt LCTRL ESC>, <&prog_caps_word>;
    )

// Shift/ESC, caps word tap dance.
ZMK_BEHAVIOR(td_sft_esc_caps, tap_dance,
        tapping-term-ms = <130>;
        bindings = <&mt LSHFT ESC>, <&prog_caps_word>;
    )

// Home row mods
ZMK_BEHAVIOR(lht, hold_tap,
    flavor = "tap-preferred";
    hold-trigger-key-positions = < 
      RT0 RT1 RT2 RT3 RT4 RT5 
      RM0 RM1 RM2 RM3 RM4 RM5 
      RB0 RB1 RB2 RB3 RB4 RB5 
      RH0 RH1 RH2
      LM3 LM4 LB1 LB2 LT3
    >;
    global-quick-tap;
    tapping-term-ms = <180>;
    quick-tap-ms = <80>;
    bindings = <&kp>, <&kp>;
    )

ZMK_BEHAVIOR(rht, hold_tap,
    flavor = "balanced";
    hold-trigger-key-positions = < 
      LT0 LT1 LT2 LT3 LT4 LT5 
      LM0 LM1 LM2 LM3 LM4 LM5 
      LB0 LB1 LB2 LB3 LB4 LB5 
      LH0 LH1 LH2
      RT1
    >;
    tapping-term-ms = <200>;
    global-quick-tap;
    quick-tap-ms = <100>;
    bindings = <&kp>, <&kp>;
    )

ZMK_BEHAVIOR(n_lt, hold_tap,
    flavor = "tap-preferred";
    global-quick-tap;
    tapping-term-ms = <150>;
    quick-tap-ms = <90>;
    hold-trigger-key-positions = < 
      RT1 RT2 RT3
      RM1 RM2 RM3
      RB1 RB2 RB3
      RH1
    >;
    bindings = <&mo>, <&kp>;
    )

// for cmd+tab with SYMBOL + caps
ZMK_BEHAVIOR(swapper, tri_state,
    bindings = <&kt LGUI>, <&kp TAB>, <&kt LGUI>;
    ignored-key-positions = <LM5>;
    )

// for cmd+tilda with SYMBOL + tilde
ZMK_BEHAVIOR(swapper_tilde, tri_state,
    bindings = <&kt LGUI>, <&kp TILDE>, <&kt LGUI>;
    ignored-key-positions = <LT5>;
    )

// BSPC, shift as delete
ZMK_BEHAVIOR(bspc_del, mod_morph,
    bindings = <&kp BSPC>, <&kp DEL>;
    mods = <(MOD_LSFT|MOD_RSFT)>;
    )


// combos
ZMK_COMBO(combo_lbkt, &kp LBKT, RB1 RB2, DEFAULT)
ZMK_COMBO(combo_rbkt, &kp RBKT, RB2 RB3, DEFAULT)
ZMK_COMBO(combo_esc, &kp ESC, RM1 RM2, DEFAULT)
ZMK_COMBO(combo_tab, &kp TAB, LB1 LB2, ALL)
ZMK_COMBO(combo_paste, &kp LC(LS(V)), LM4 LM3 LB1, ALL)
ZMK_COMBO(combo_lock, &kp LG(L), RB1 RB2, SYMBOL)

/ {
        keymap {
                compatible = "zmk,keymap";
                default_layer {
                        label = "QWERTY";
// -----------------------------------------------------------------------------------------
// |  TAB  |  Q  |  W  |  E  |  R  |  T     |   |  Y      |  U   |  I  |  O  |  P  | BKSP |
// | S/CAP |  A  |  S  |  D  |  F  |  G     |   |  H      |  J   |  K  |  L  |  ;  |  '   |
// | SHIFT |  Z  |  X  |  C  |  V  |  B     |   |  N      |  M   |  ,  |  .  |  /  | ENT  |
//                     | GUI | SYM | NAV_ENT|   | sk SHIFT| SPC  | GUI |
                        bindings = <
//╭──────────┬─────────────┬─────────────┬───────┬─────────────┬─────────────╮   ╭───────────┬─────────┬─────────────┬────────┬────────┬────────╮
   &kp TAB    &kp Q         &kp W         &kp E   &kp R         &kp T             &kp Y       &kp U     &kp I         &kp O    &kp P    &bspc_del
//├──────────┼─────────────┼─────────────┼───────┼─────────────┼─────────────┤   ├───────────┼─────────┼─────────────┼────────┼────────┼────────┤
   &td_caps   &lht LCTRL A  &lht LSHFT S  &kp D   &n_lt NUMPAD F &kp G            &kp H       &kp J     &rht LCTRL K  &kp L    &kp SEMI &kp SQT
//├──────────┼─────────────┼─────────────┼───────┼─────────────┼─────────────┤   ├───────────┼─────────┼─────────────┼────────┼────────┼────────┤
   &kp LALT   &kp Z         &kp X         &kp C   &kp V         &kp B             &kp N       &kp M     &kp COMMA     &kp DOT  &kp FSLH &lt PSCR RET
//╰──────────┼─────────────┼─────────────┼───────┼─────────────┼─────────────┤   ├───────────┼─────────┼─────────────┼────────┼────────┼────────╯
                                         &kp LGUI &mo SYMBOL    &lt NAV RET       &sk LSHIFT  &kp SPACE &kp LGUI
//                                       ╰───────┴─────────────┴─────────────╯   ╰───────────┴─────────┴─────────────╯

                        >;
                };

                symbol_layer {
                        label = "SYMBOL";
// -----------------------------------------------------------------------------------------
// |⌘-w  |  !  |  @  |  #  |  $  |  %     |   |  ^      |  &  |  *  |  (  |  )  | ALT+BKSP|
// |G-Tab|  [  |  {  |  }  |  ]  | ⌘-t    |   | c-^     |  -  |  =  |  _  |  :  |  "      |
// | G-~ |  |  |  `  |  \  |  ~  | c-␣    |   |         |  +  |  <  |  >  |  ?  |TO(LAYERS|
//                   | GUI | SYM | NAV_ENT|   | FUNC    | 0   | CTRL|
                        bindings = <
//╭──────────┬─────────┬─────────┬─────────┬───────┬─────────────╮   ╭─────────────┬─────────┬─────────┬─────────┬──────────┬───────╮
   &kp LG(W)      &kp EXCL  &kp AT   &kp HASH  &kp DLLR &kp PRCNT         &kp CARET     &kp AMPS  &kp STAR  &kp LPAR  &kp RPAR  &kp LA(BSPC)
//├──────────┼─────────┼─────────┼─────────┼───────┼─────────────┤   ├─────────────┼─────────┼─────────┼─────────┼──────────┼───────┤
   &swapper   &kp LBKT  &kp RBKT &kp LBRC  &kp RBRC &kp LG(T)         &kp LC(CARET) &kp MINUS &kp EQUAL &kp UNDER &kp COLON  &kp DQT
//├──────────┼─────────┼─────────┼─────────┼───────┼─────────────┤   ├─────────────┼─────────┼─────────┼─────────┼──────────┼───────┤
   &swapper_tilde &kp PIPE  &kp GRAVE &kp BSLH &kp TILDE &kp LC(SPACE)     XXXX         &kp PLUS  &kp LT    &kp GT    &kp QMARK ____
//╰──────────┼─────────┼─────────┼─────────┼───────┼─────────────┤   ├─────────────┼─────────┼─────────┼─────────┼──────────┼───────╯
                                  &to NUMPAD  ____   &to NAV              &mo FUNC  &kp LG(SPACE)  ____
//                               ╰─────────┴───────┴─────────────╯   ╰─────────────┴─────────┴─────────╯
                        >;
                };

                func_layer {
                        label = "FUNC";
// ╭──────┬───────┬─────┬─────┬─────┬─────╮   ╭─────┬──────────┬─────┬─────┬─────┬──────╮
// |  F1  | F2    | F3  | F4  | F5  | F6  |   | F7  | F8       | F9  | F10 | F11 |  F12 |
// | BTCLR| BT1   | BT2 | BT3 | BT4 | BT5 |   |     |          |     |     |     |      |
// | RESET|OUT_TOG|     |     |     |     |   |     |          |     |     |     |      |
//                      |     |     |     |   |     |BOOTLOADER|     |
//                      ╰─────┴─────┴─────╯   ╰─────┴──────────┴─────╯
                        bindings = <
//╭──────────┬─────────┬────────┬──────┬───────┬───────╮   ╭──────┬─────────┬─────────┬─────────┬──────────┬───────╮
   &kp F1      &kp F2   &kp F3   &kp F4 &kp F5  &kp F6      &kp F7  &kp F8   &kp F9    &kp F10   &kp F11    &kp F12
//├──────────┼─────────┼────────┼──────┼───────┼───────┤   ├──────┼─────────┼─────────┼─────────┼──────────┼───────┤
   &bt BT_CLR  BT(0)    BT(1)    BT(2)  BT(3)   BT(4)        ____   ____     ____      ____      ____       ____
//├──────────┼─────────┼────────┼──────┼───────┼───────┤   ├──────┼─────────┼─────────┼─────────┼──────────┼───────┤
   ____       &out OUT_TOG ____  ____   &reset  &bootloader &bootloader &reset ____      ____      ____       ____
//╰──────────┼─────────┼────────┼──────┼───────┼───────┤   ├──────┼─────────┼─────────┼─────────┼──────────┼───────╯
                                 ____    ____    ____         ____  ____     ____
//                              ╰──────┴───────┴───────╯   ╰──────┴─────────┴─────────╯
                        >;
                };

                nav_layer {
                        label = "NAVI";
// -----------------------------------------------------------------------------------------
// |  TAB |G(1) |G(2) |G(3) |G(4) |G(5) |   |HOME |PG_UP| END |     |     |      |
// |      |CTRL |SHIFT|LGUI |LALT |CTRL |   | LFT | DWN |  UP | RGT |     |      |
// |      |     |     |MUTE |VOL- |VOL+ |   |     |  -  |  =  |     |     | ENT  |
//                    | GUI |G(A) |     |   | SHFT|     | ALT |
                        bindings = <
//╭──────┬──────────┬─────────┬───────────┬────────────┬────────────╮   ╭────────┬─────────┬─────────┬──────┬─────┬───────╮
   ____   &kp LG(N1) &kp LG(N2) &kp LG(N3) &kp LG(N4)   &kp LG(N5)       &kp HOME &kp PG_UP &kp END   XXXX   XXXX  XXXX
//├──────┼──────────┼─────────┼───────────┼────────────┼────────────┤   ├────────┼─────────┼─────────┼──────┼─────┼───────┤
   ____   &kp LCTRL  &kp LSHFT &kp LGUI    &kp LALT     &kp LCTRL        &kp LEFT &kp DOWN  &kp UP  &kp RIGHT  XXXX  XXXX
//├──────┼──────────┼─────────┼───────────┼────────────┼────────────┤   ├────────┼─────────┼─────────┼──────┼─────┼───────┤
   XXXX   XXXX       XXXX      &kp C_MUTE  &kp C_VOL_DN &kp C_VOL_UP     XXXX     &kp MINUS &kp EQUAL XXXX   XXXX  ____ 
//╰──────┼──────────┼─────────┼───────────┼────────────┼────────────┤   ├────────┼─────────┼─────────┼──────┼─────┼───────╯
                       	        ____       &kp LG(LALT)  &to DEFAULT      ____      &kp LA(SPACE)     ____
//                            ╰───────────┴────────────┴────────────╯   ╰────────┴─────────┴─────────╯
                        >;
                };

                num_layer {
                        label = "NUMPAD";
// -----------------------------------------------------------------------------------------
// | TAB  |       |       |C(A(G))     |     |       |   |     |  7  |  8  |  9  |  +  |   |
// |S(ALT)|S(CTRL)|S(SHFT)|S(GUI)|     |       |   |     |  4  |  5  |  6  |  -  | * |
// | SHFT | LGUI  |       |      |     |       |   |     |  1  |  2  |  3  |  /  | = |
//                        | GUI  | SYM |NAV_ENT|   |P_ENT|  0  | .   |
                        bindings = <
//╭─────────┬──────────┬─────────┬───────────┬──────┬──────╮   ╭───────────┬───────┬───────┬──────┬─────────┬──────────╮
   ____      ____       ____      &kp LC(LA(LGUI)) ____   ____       &to DEFAULT &kp N7  &kp N8  &kp N9  &kp PLUS  ____
//├─────────┼──────────┼─────────┼───────────┼──────┼──────┤   ├───────────┼───────┼───────┼──────┼─────────┼──────────┤
   &sk LALT  &sk LCTRL  &sk LSHFT  &sk LGUI   ____   ____        ____       &kp N4  &kp N5  &kp N6  &kp MINUS &kp STAR
//├─────────┼──────────┼─────────┼───────────┼──────┼──────┤   ├───────────┼───────┼───────┼──────┼─────────┼──────────┤
   &kp LSHFT &kp LGUI   ____      ____        ____   ____        ____       &kp N1  &kp N2  &kp N3  &kp SLASH &kp EQUAL
//╰─────────┼──────────┼─────────┼───────────┼──────┼──────┤   ├───────────┼───────┼───────┼──────┼─────────┼──────────╯
                                  ____        ____   ____       &kp KP_ENTER &kp N0 &kp DOT 
//                               ╰───────────┴──────┴──────╯   ╰───────────┴───────┴───────╯
                        >;
                }; // num_layer

                screenshot_layer {
                        label = "PSCR";
                        bindings = <
//╭────────┬─────────┬─────────┬─────┬─────┬────╮   ╭─────┬─────┬─────┬──────┬────┬─────────╮
   XXXX     XXXX      XXXX      XXXX  XXXX  XXXX     XXXX  XXXX  XXXX  XXXX  XXXX  &kp LS(PSCRN)
//├────────┼─────────┼─────────┼─────┼─────┼────┤   ├─────┼─────┼─────┼──────┼────┼─────────┤
   XXXX     &kp LCTRL &kp LSHFT XXXX  XXXX  XXXX     XXXX  XXXX  XXXX  XXXX  XXXX  &kp PSCRN
//├────────┼─────────┼─────────┼─────┼─────┼────┤   ├─────┼─────┼─────┼──────┼────┼─────────┤
   &kp LALT  XXXX      XXXX      XXXX  XXXX  XXXX     XXXX  XXXX  XXXX  XXXX  XXXX  ____
//╰────────┼─────────┼─────────┼─────┼─────┼────┤   ├─────┼─────┼─────┼──────┼────┼─────────╯
                                ____  ____  ____     ____  ____  ____
//                             ╰─────┴─────┴────╯   ╰─────┴─────┴─────╯
                        >;
                }; // screenshot layr

        };  // keymap

}; // root

